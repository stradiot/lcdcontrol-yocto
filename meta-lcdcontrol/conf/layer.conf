## meta-rpi-config/conf/layer.conf
```bitbake
LAYERSERIES_COMPAT_-rpi-config = "scarthgap"
LCONF_VERSION = "7"

BBPATH .= ":${LAYERDIR}"

BBFILES += "${LAYERDIR}/recipes-*/*/*.bb \
            ${LAYERDIR}/recipes-*/*/*.bbappend"

BBFILE_COLLECTIONS += "rpi-config"
BBFILE_PATTERN_rpi-config = "^${LAYERDIR}/"
BBFILE_PRIORITY_rpi-config = "10"
```

## meta-stradiot-rpi-config/conf/layer.conf
```bitbake
LAYERSERIES_COMPAT_stradiot-rpi-config = "scarthgap"
LCONF_VERSION = "7"

BBPATH .= ":${LAYERDIR}"

BBFILES += "${LAYERDIR}/recipes-*/*/*.bb \
            ${LAYERDIR}/recipes-*/*/*.bbappend"

BBFILE_COLLECTIONS += "stradiot-rpi-config"
BBFILE_PATTERN_stradiot-rpi-config = "^${LAYERDIR}/"
BBFILE_PRIORITY_stradiot-rpi-config = "10"
```
